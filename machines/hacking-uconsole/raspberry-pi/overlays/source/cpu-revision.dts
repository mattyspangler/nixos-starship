/dts-v1/;
/plugin/;

/{
  compatible = "brcm,bcm2711";

  fragment@0 {
    target-path = "/";
    __overlay__ {
      frag0: system {
        linux,revision = <0x00d03114>;
      };
    };
  };

  __overrides__ {
    pi4 = <&frag0>,"linux,revision:0=",<0x00d03114>;
    cm4-8 = <&frag0>,"linux,revision:0=",<0x00d03140>;
  };
};
